## soc/infineon/edge/pse84/Kconfig
```kconfig
# SPDX-FileCopyrightText: Copyright (c) 2026 Infineon Technologies AG,
# SPDX-FileCopyrightText: or an affiliate of Infineon Technologies AG. All rights reserved.
#
# SPDX-License-Identifier: Apache-2.0

config SOC_SERIES_PSE84
	select ARM
	select CPU_HAS_FPU
	select ARMV8_M_DSP
	select CPU_HAS_ARM_MPU
	select BUILD_OUTPUT_HEX
	select BUILD_OUTPUT_BIN
	select DYNAMIC_INTERRUPTS
	select SOC_EARLY_INIT_HOOK
	select HAS_PM
	select PM_STATE_SET_IRQ_UNLOCKED
	select HAS_POWEROFF
	select CPU_HAS_CUSTOM_FIXED_SOC_MPU_REGIONS

config SOC_SERIES_PSE84_M33
	select CPU_CORTEX_M33
	select CPU_HAS_ARM_SAU
	select ARM_TRUSTZONE_M
	select ARCH_HAS_TRUSTED_EXECUTION

config SOC_SERIES_PSE84_M55
	select CPU_CORTEX_M55
	select ARMV8_1_M_MVEI
	select ARMV8_1_M_MVEF
	select CACHE_MANAGEMENT

config SOC_SERIES_PSE84_M33
	select SOC_LATE_INIT_HOOK

config PSOC_EDGE_M55_SRF_SUPPORT
	bool "Select whether to enable the SRF support on m55"
	select USE_INFINEON_ABSTRACTION_RTOS
	help
	  This option enables the SRF support on m55 core on pse84 and the infrastructure setup on m33/ns to deal with that.

if SOC_SERIES_PSE84_M33

config SOC_PSE84_M55_ENABLE
	bool "pse84 m55 core is enabled during setup"
	help
	  This option enables the m55 core on pse84, by m33 core.

endif # SOC_SERIES_PSE84_M33

config SOC_PSE84_LPM_TIMER
	bool
	default y if SYSTEM_TIMER_LPM_COMPANION_HOOKS
	select USE_INFINEON_LPTIMER
	help
	  Enable MCWDT as a low-power companion timer for the SysTick.
	  The MCWDT runs from PILO (32 kHz) and provides timekeeping
	  during deepsleep when HF clocks (and thus SysTick) are stopped.

config PSE84_SECURE_IMAGE_KEY_FILE
	string "OEM key file for signing the PSE84 CM33 secure image"
	default ""
	help
	  Path to the OEM private key (PEM) passed to imgtool as --key when
	  pse84_add_metadata_secure_hex() adds the MCUboot metadata to the
	  CM33 secure image. Empty (the default) leaves the image with format
	  and hash only, which is what a non-provisioned / DEVELOPMENT-LCS
	  device expects. Set this once the device has been provisioned for
	  secure boot and its lifecycle transitioned, so the ROM extended
	  boot verifies the image signature against the provisioned key.

config PSE84_SECURE_IMAGE_SECURITY_COUNTER
	string "Security counter for the PSE84 CM33 secure image"
	default ""
	help
	  Value passed to imgtool as --security-counter for the CM33 secure
	  image. Empty (the default) omits --security-counter. Accepts an
	  integer or the literal "auto".
```
