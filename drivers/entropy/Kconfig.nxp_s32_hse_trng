## drivers/entropy/Kconfig.nxp_s32_hse_trng
```kconfig
# Copyright 2025 NXP
# SPDX-License-Identifier: Apache-2.0

config ENTROPY_NXP_S32_HSE_TRNG
	bool "NXP S32 HSE TRNG driver"
	default y
	depends on DT_HAS_NXP_S32_HSE_ENTROPY_ENABLED
	select ENTROPY_HAS_DRIVER
	help
	  Enable the NXP S32 HSE true random number generator (TRNG) driver. Sources entropy via
	  the HSE firmware's Get Random Number service (HSE_SRV_ID_GET_RANDOM_NUM), over a Messaging
	  Unit instance separate from the one used by CRYPTO_NXP_S32_HSE.
```

## drivers/flash/Kconfig.infineon_fram_shim
```kconfig
# NDR Solution FRAM-backed flash-API shim driver
#
# Copyright (c) 2026 NDR Solution (Thailand) Co., Ltd.
#
# SPDX-License-Identifier: Apache-2.0

config FLASH_INFINEON_FRAM_SHIM
	bool "FRAM-backed flash-API shim driver"
	default y
	depends on DT_HAS_INFINEON_FRAM_FLASH_ENABLED
	select FRAM
	select FLASH_HAS_DRIVER_ENABLED
	select FLASH_HAS_PAGE_LAYOUT
	select FLASH_HAS_EXPLICIT_ERASE
	help
	  Wrap a FRAM device (CONFIG_FRAM) with the flash_driver_api so it can
	  back flash-only consumers (Settings ZMS/NVS, FLASH_MAP, the flash
	  shell). Erase is emulated by writing the erase value across the
	  requested range, since FRAM needs no physical erase-before-write.

config FLASH_INFINEON_FRAM_SHIM_INIT_PRIORITY
	int "FRAM flash shim init priority"
	default 60
	depends on FLASH_INFINEON_FRAM_SHIM
	help
	  Must run after the backing FRAM device initializes
	  (CONFIG_FRAM_INIT_PRIORITY, default KERNEL_INIT_PRIORITY_DEVICE = 50)
	  so device_is_ready() on the backing device succeeds.
```

## dts/bindings/mbox/infineon,mbox.yaml
```yaml
# SPDX-FileCopyrightText: Copyright (c) 2026 Infineon Technologies AG,
# SPDX-FileCopyrightText: or an affiliate of Infineon Technologies AG. All rights reserved.
#
# SPDX-License-Identifier: Apache-2.0

description: |
  Infineon IPC block exposed as a Zephyr MBOX controller.

  This driver implements the Multi-Channel Inter-Processor Mailbox (MBOX) API
  on top of the Infineon inter-processor communication (IPC) block using direct
  register access. Each mailbox channel carries one or two 32-bit data words,
  selected per controller by "msg-size-bytes".

  A mailbox channel is described by one "ipc-configs" entry and one
  "interrupts" entry, at the same index:

    * ipc-configs = <&ipcX channel interrupt>
        &ipcX     - phandle of the IPC instance the channel belongs to,
        channel   - IPC channel index within that instance,
        interrupt - IPC interrupt-structure index within that instance the
                    receiver watches on this channel.
    * interrupts  - NVIC vector, on this core, of that interrupt structure.

  The channel index passed by consumers through "#mbox-cells = <1>" is the
  index into these arrays, not an IPC channel number.

  Any core may use any IPC instance; there is no fixed instance-to-core
  mapping. A controller may reference any instance and may even mix instances
  across its channels. Only the "interrupts" entry is core-specific: it must be
  the NVIC vector of the chosen interrupt structure in the servicing core's own
  vector table.

  Example:

    &ipc0 {
        status = "okay";
    };

    mbox0: mbox {
        compatible = "infineon,mbox";
        #mbox-cells = <1>;
        ipc-configs = <&ipc0 3 3>, <&ipc0 4 4>;
        interrupts = <73 4>, <74 4>;
        status = "okay";
    };

compatible: "infineon,mbox"

include: [base.yaml, mailbox-controller.yaml]

properties:
  interrupts:
    required: true

  ipc-configs:
    type: phandle-array
    required: true
    description: |
      One entry per mailbox channel, selecting the IPC instance, channel and
      interrupt structure that channel uses. Its length must match the number
      of "interrupts" entries.

  msg-size-bytes:
    type: int
    default: 8
    enum: [0, 4, 8]
    description: |
      Fixed message size, in bytes, carried by every channel of this
      controller. 4 bytes uses IPC DATA0 only; 8 bytes uses DATA0 and DATA1 and
      requires an IPC block that implements DATA1 (M33SYSCPUSS, M7CPUSS or
      M4CPUSS v2, e.g. PSE84 and TRAVEO T2G). Use 4 on IP that has only DATA0
      (e.g. M4CPUSS v1). Defaults to 8 to match the PSE84 series.

      0 selects signalling mode (mbox_mtu_get() returns 0, mbox_send() takes a
      NULL message, callbacks get a NULL message). A send only raises the
      receiver's interrupt, so it never returns -EBUSY and no data is lost.
      The ipc backends that signal with a NULL message (icmsg, icbmsg) need it.

  tx-only-mask:
    type: int
    default: 0
    description: |
      Bitmask over the "ipc-configs" indices (bit i = entry i). A set bit marks
      a channel that this core only sends on. It may not be enabled with
      mbox_set_enabled() (-EINVAL) and is ignored by the check that rejects two
      receive channels sharing one interrupt structure.
      Its "interrupts" entry is still required so both arrays keep the same
      length. The driver connects that vector like any other but never enables
      it, so give it a valid vector of this core that no other entry uses.
      An mbox_send() on a transmit-only channel notifies the interrupt
      structure named in its "ipc-configs" entry, which is the one the peer
      core receives on.

mbox-cells:
  - channel
```

## dts/bindings/mtd/infineon,fram-flash.yaml
```yaml
# Copyright (c) 2026 NDR Solution (Thailand) Co., Ltd.
# SPDX-License-Identifier: Apache-2.0

description: |
  Zephyr flash-API shim over a FRAM device. Wraps an existing `fram`-class
  device (see drivers/fram/, e.g. infineon,cy15xq) and re-exposes it as a
  `flash` class device so flash-only consumers (Settings ZMS/NVS backends,
  fixed-partitions/FLASH_MAP, the flash shell) can use a small
  byte-addressable FRAM chip as their backing store.

compatible: "infineon,fram-flash"

include: base.yaml

properties:
  fram:
    type: phandle
    required: true
    description: Backing FRAM device (must expose the `fram` class API and a `size` property).

  erase-block-size:
    type: int
    required: true
    description: |
      Synthetic sector size (bytes) reported through the flash page-layout
      API. FRAM has no physical erase-block constraint; this only exists
      so consumers that need CONFIG_FLASH_PAGE_LAYOUT (e.g. ZMS) can
      compute a sector count for garbage collection.

  write-block-size:
    type: int
    default: 1
    description: Minimum write alignment reported through the flash API (FRAM allows byte writes).
```

## dts/bindings/pwm/infineon,tcpwm-pwm.yaml
```yaml
# SPDX-FileCopyrightText: Copyright (c) 2026 Infineon Technologies AG,
# SPDX-FileCopyrightText: or an affiliate of Infineon Technologies AG. All rights reserved.
#
# SPDX-License-Identifier: Apache-2.0

description: Infineon TCPWM PWM

compatible: "infineon,tcpwm-pwm"

include: [base.yaml, pwm-controller.yaml, pinctrl-device.yaml, "infineon,system-interrupts.yaml"]

properties:
  "#pwm-cells":
    const: 3
    description: |
      Number of items to expect in a PWM
      - channel of the timer used for PWM (not used)
      - period to set in ns
      - flags: standard flags like PWM_POLARITY_NORMAL

  pinctrl-0:
    description: |
      PORT pin configuration for the PWM signal.
      We expect that the phandles will reference pinctrl nodes. These
      nodes will have a nodelabel that matches the Infineon SoC Pinctrl
      defines and have following
      format: p<port>_<pin>_<peripheral inst>_<signal>.

      Examples:
        pinctrl-0 = <&p1_1_pwm0_0>;
    required: true

  pinctrl-names:
    required: true

  capture-input:
    type: boolean
    description: |
      Configure this instance as a PWM input-capture channel instead of an
      output. The TCPWM block is initialized as a free-running up-counter
      with independent rising-edge (CC0) and falling-edge (CC1) capture on
      the pinctrl-selected input pin, both routed via CY_TCPWM_INPUT_TRIG_0
      (the instance's own dedicated capture trigger). Requires
      CONFIG_PWM_CAPTURE. set_cycles()/get_cycles_per_sec() output-mode
      calls are rejected (-ENOTSUP) on a capture-mode instance.

  trigmux-in:
    type: int
    description: |
      Required alongside capture-input. Trigger-mux input selector (e.g.
      PERI_0_TRIG_IN_MUX_x_..._TR_OUTn from the SoC's generated trigger
      table) that the pinctrl-selected pin's HSIOM function feeds into.
      Connected to trigmux-out via Cy_TrigMux_Connect() at init.

  trigmux-out:
    type: int
    description: |
      Required alongside capture-input. Trigger-mux output selector (e.g.
      PERI_0_TRIG_OUT_MUX_x_TCPWM0_..._TR_INn) that feeds this instance's
      CY_TCPWM_INPUT_TRIG_0 capture input. Connected to trigmux-in via
      Cy_TrigMux_Connect() at init.

pwm-cells:
  - channel
  - period
  - flags
```

## dts/bindings/rng/nxp,s32-hse-entropy.yaml
```yaml
# Copyright 2025 NXP
# SPDX-License-Identifier: Apache-2.0

description: |
  NXP S32 HSE Messaging Unit, dedicated to entropy (TRNG) service requests. Sibling of
  nxp,s32-crypto-hse-mu (crypto/) - same Messaging Unit hardware, different host-side MU instance
  and Zephyr driver (entropy_nxp_s32_hse_trng.c), so that the entropy and crypto services in the
  HSE firmware core don't contend over one host MU. To enable:
    &mub1 {
      status = "okay";
    };

compatible: "nxp,s32-hse-entropy"

include: base.yaml

properties:
  reg:
    required: true
```

## dts/bindings/sdhc/infineon,sdhc-sdio.yaml
```yaml
# SPDX-FileCopyrightText: Copyright (c) 2026 Infineon Technologies AG,
# SPDX-FileCopyrightText: or an affiliate of Infineon Technologies AG. All rights reserved.
#
# SPDX-License-Identifier: Apache-2.0

description: Infineon CAT1 SDHC/SDIO controller

compatible: "infineon,sdhc-sdio"

include: [sdhc.yaml, pinctrl-device.yaml, "infineon,system-interrupts.yaml"]

properties:
  reg:
    required: true

  pinctrl-0:
    required: true

  pinctrl-names:
    required: true

  interrupts:
    description: Required for non-cat1c devices

  system-interrupts:
    description: Required for cat1c devices

  bus-width:
    type: int
    default: 4
    description: |
      bus width for SDMMC access, defaults to the minimum necessary
      number of bus lines
    enum:
      - 1
      - 4
      - 8

  no-1-8-v:
    type: boolean
    description: |
      The SD/MMC bus on the board doesn't support the 1.8V voltage,
      Which disables UHS-I, HS200 and HS400 support.

  no-3-3-v:
    type: boolean
    description: |
      When the bus I/O voltage is hard-wired to 1.8V and the board does
      not support 3.3V signaling, add this property to disable 3.3V card
      voltage of the controller. This makes the SD subsystem start the
      card initialization at 1.8V instead of 3.3V.

  cd-gpios:
    type: phandle-array
    description: Card Detect pin

  clk-dst:
    type: int
    description: Peripheral clock destination ID for this TCPWM instance
```

## dts/bindings/wifi/infineon,airoc-wifi.yaml
```yaml
# Copyright (c) 2023 Cypress Semiconductor Corporation (an Infineon company) or
# an affiliate of Cypress Semiconductor Corporation
#
# SPDX-License-Identifier: Apache-2.0

description: |
    AIROC Wi-Fi Connectivity.

compatible: "infineon,airoc-wifi"

include: [base.yaml, pinctrl-device.yaml]

properties:
  wifi-reg-on-gpios:
    description: |
      Power-up/down gpio to control the internal regulators used
      by the WiFi section of AIROC Wi-Fi device.
    type: phandle-array

  wifi-host-wake-gpios:
    description: |
      Host wake-up gpio. Signal from the AIROC Wi-Fi device
      to the host indicating that the device requires attention.
    type: phandle-array

  wifi-dev-wake-gpios:
    description: |
      WiFi device wake-up gpio. Signal from the host to the
      AIROC Wi-Fi device indicating that the host requires attention.
      When set, the driver drives it to its active level before it
      raises WL_REG_ON and leaves it there, so the flags must say which
      level is the asserted one.
    type: phandle-array

  wifi-bt-reg-on-gpios:
    description: |
      BT_REG_ON of a combo module, which shares its chip with the Wi-Fi
      section. When set, the driver raises it once WL_REG_ON is up and has
      had its power-up delay, as the start of Infineon's Bluetooth open
      does. Some modules (Ezurio Sona IF513) answer on SDIO only after
      that. The Bluetooth driver can still toggle it afterwards.
    type: phandle-array

  wifi-sdio-dat2-gpios:
    description: |
      The SDIO DAT2 pin, as a gpio. Some modules (for example the Ezurio
      Sona IF513) latch the level of SDIO_DATA2 when WL_REG_ON first rises
      and need it high, which a board without a pull-up on DAT2 cannot
      guarantee. When this is set, the driver drives the pin high as a gpio
      across the WL_REG_ON rising edge and then gives it back to the SDIO
      controller by applying the default pinctrl state of this node, so
      pinctrl-0 must list the SDIO DAT2 function of the same pin.
    type: phandle-array

examples:
  - |
    &sdhc0 {
      status = "okay";

      /* SDIO pins */
      pinctrl-0 = <&p2_4_sdio_cmd &p2_5_sdio_clk &p2_0_sdio_data0
            &p2_1_sdio_data1 &p2_2_sdio_data2 &p2_3_sdio_data3>;
      pinctrl-names = "default";

      /* Wifi configuration */
      airoc-wifi {
        status = "okay";
        compatible = "infineon,airoc-wifi";

        /* Wi-Fi control gpios */
        wifi-reg-on-gpios    = <&gpio_prt2 6 GPIO_ACTIVE_HIGH>;
        wifi-host-wake-gpios = <&gpio_prt0 4 GPIO_ACTIVE_HIGH>;
      };
    };
```

## modules/hal_nxp/s32/Kconfig.nxp_s32
```kconfig
# NXP S32 MCUs family

# Copyright 2022-2023 NXP
# SPDX-License-Identifier: Apache-2.0

config HAS_NXP_S32_HAL
	bool
	select HAS_CMSIS_CORE
	depends on SOC_FAMILY_NXP_S32

# #CUSTOM@NDRS
config NXP_S32_HSE_IP
	bool
	depends on SOC_SERIES_S32K3
	help
	  Build the HSE-over-MU transport IP layer (Hse_Ip.c, Mu_Ip_Irq.c) and the
	  HSE firmware service ABI headers, independently of the Zephyr crypto and
	  entropy drivers that normally pull them in. Select this when talking to
	  the HSE firmware directly through Hse_Ip_ServiceRequest() - e.g. during
	  HSE provisioning/bring-up, before CRYPTO_NXP_S32_HSE or
	  ENTROPY_NXP_S32_HSE_TRNG can safely be enabled.
```
