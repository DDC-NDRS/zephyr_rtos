## drivers/fram/Kconfig
```kconfig
# FRAM driver configuration options

# Copyright (c) 2019 Vestas Wind Systems A/S
# Copyright (c) 2023 NDR Solution (Thailand) Co., Ltd.
# SPDX-License-Identifier: Apache-2.0

menuconfig FRAM
	bool "FRAM hardware support"
	help
	  Enable support for FRAM hardware.

if FRAM

module = FRAM
module-str = fram
source "subsys/logging/Kconfig.template.log_config"

config FRAM_INIT_PRIORITY
	int "FRAM init priority"
	default KERNEL_INIT_PRIORITY_DEVICE
	help
	  FRAM driver device initialization priority.

config FRAM_SHELL
	bool "FRAM shell"
	default n
	depends on SHELL
	help
	  Enable the FRAM shell with FRAM related commands.

config FRAM_SHELL_BUFFER_SIZE
	int "FRAM shell buffer size"
	default 256
	depends on FRAM_SHELL
	help
	  Size of the buffer used for FRAM read/write commands in
	  the FRAM shell.

# CUSTOM@NDRS: selected by FRAM_CY15XJ / FRAM_CY15XQ only. A default y here compiled the driver on a core whose
# devicetree has no FRAM (the bcu-mv25 M55), which left fram_cy15x_init() unused.
config FRAM_CY15X
	bool
	help
	  Enable support for Infineon CY15X (and compatible) I2C/SPI
	  FRAMs.

# CUSTOM@NDRS: a probe for the settings store (ZMS), which saw "Invalid data CRC" at boot on the bcu-mv25.
config FRAM_CY15X_VERIFY
	bool "Verify every FRAM read and write"
	depends on FRAM_CY15X
	help
	  Read every block twice and compare the two reads, and read every written block back. A block that
	  differs is logged with the offset, the number of bytes that differ and the first and last one, and is
	  read or written again. Tells a block that was read wrong from one that was written wrong. Doubles the
	  read time of the store.

config FRAM_CY15XJ
	bool "Infineon CY15J (and compatible) I2C FRAM support"
	default y
	depends on DT_HAS_INFINEON_CY15XJ_ENABLED
	select I2C
	select FRAM_CY15X
	help
	  Enable support for Infineon CY15J (and compatible) I2C FRAMs.

config FRAM_CY15XQ
	bool "Infineon CY15Q (and compatible) SPI FRAM support"
	default y
	depends on DT_HAS_INFINEON_CY15XQ_ENABLED
	select SPI
	select FRAM_CY15X
	help
	  Enable support for Infineon CY15Q (and compatible) SPI FRAMs.

endif # FRAM
```

## dts/bindings/ethernet/phy/marvell,88e1510.yaml
```yaml
# SPDX-License-Identifier: Apache-2.0

description: Marvell 88E1510 Gigabit Ethernet PHY

compatible: "marvell,88e1510"

include:
  - name: ethernet-phy-common.yaml
  - name: ethernet-phy-reset-gpios.yaml

on-bus: mdio

properties:
  no-reset:
    type: boolean
    description: Do not reset the PHY during initialization

  int-gpios:
    type: phandle-array
    description: |
      GPIO connected to the LED[2]/INTn pin of the PHY, active low. When present, the driver
      routes INTn to that pin and enables the auto-negotiation complete, link, speed and duplex
      change interrupts to react to link changes without waiting for the next poll. The periodic
      poll stays active as a fallback. LED[2] is then not available as a LED.

  led0-function-select:
    type: string
    default: "link-activity"
    description: LED0 Function Select
    enum:
      - "#0"
      - "#1"
      - "link-speed"
      - "#3"
      - "link-activity"

  led1-function-select:
    type: string
    default: "link-speed"
    description: LED1 Function Select
    enum:
      - "#0"
      - "#1"
      - "#2"
      - "#3"
      - "link-activity"
      - "#5"
      - "link-speed"

  default-speeds:
    default:
      - "1000BASE Full-Duplex"
      - "100BASE Full-Duplex"
      - "10BASE Full-Duplex"
```

## dts/bindings/ethernet/phy/microchip,lan8710ai.yaml
```yaml
# Copyright (c) 2026
# SPDX-License-Identifier: Apache-2.0

description: Microchip LAN8710A/LAN8710AI Single Port Ethernet PHY

compatible: "microchip,lan8710ai"

include:
  - name: ethernet-phy-common.yaml
  - name: ethernet-phy-reset-gpios.yaml

on-bus: mdio

properties:
  no-reset:
    type: boolean
    description: Do not reset the PHY during initialization

  reg:
    required: true
    description: |
      5-bit MDIO PHY address for the attached PHY.

  int-gpios:
    type: phandle-array
    description: |
      GPIO connected to the nINT pin of the PHY, active low. When present, the driver enables
      the auto-negotiation complete and link down interrupts to react to link changes without
      waiting for the next poll. The periodic poll stays active as a fallback. The nINT/TXER/
      TXD4 pin must be configured as nINT (nINTSEL strap floating or high).

  mdix-mode:
    type: string
    default: "auto"
    description: |
      HP Auto-MDIX control. "auto" enables automatic crossover detection, "mdi" and "mdix"
      force the channel (TX transmits for MDI, TX receives for MDIX).
    enum:
      - "auto"
      - "mdi"
      - "mdix"

  energy-detect-power-down:
    type: boolean
    description: |
      Enable the energy detect power-down mode: the transceiver powers down while no cable
      energy is detected.

  default-speeds:
    default: ["10BASE Half-Duplex", "10BASE Full-Duplex", "100BASE Half-Duplex",
              "100BASE Full-Duplex"]
```

## dts/bindings/ethernet/phy/microchip,lan8742.yaml
```yaml
# Copyright (c) 2025 STMicroelectronics
# SPDX-License-Identifier: Apache-2.0

description: Single Port Ethernet PHY with RMII 10/100 trancsceiver

compatible: "microchip,lan8742"

include:
  - name: ethernet-phy-common.yaml
  - name: ethernet-phy-reset-gpios.yaml

on-bus: mdio

properties:
  reg:
    required: true
    description: |
      5-bit MDIO PHY address for the attached PHY.

  no-reset:
    type: boolean
    description: Do not reset the PHY during initialization

  int-gpios:
    type: phandle-array
    description: |
      GPIO connected to the nINT output of the PHY, active low. When present, the driver
      enables the auto-negotiation complete and link down interrupts to react to link changes
      without waiting for the next poll. The periodic poll stays active as a fallback. The pin
      must be provided by the nINT/REFCLKO pin (nINTSEL strap high) or by a LED pin selected as
      nINT with led1-function-select or led2-function-select.

  mdix-mode:
    type: string
    default: "auto"
    description: |
      HP Auto-MDIX control. "auto" enables automatic crossover detection, "mdi" and "mdix"
      force the channel (TX transmits for MDI, TX receives for MDIX).
    enum:
      - "auto"
      - "mdi"
      - "mdix"

  energy-detect-power-down:
    type: boolean
    description: |
      Enable the energy detect power-down mode: the transceiver powers down while no cable
      energy is detected.

  led1-function-select:
    type: string
    default: "link-activity"
    description: LED1 Function Select
    enum:
      - "link-activity"
      - "#int"
      - "#pme"
      - "link-speed"

  led2-function-select:
    type: string
    default: "link-speed"
    description: LED2 Function Select
    enum:
      - "link-speed"
      - "#int"
      - "#pme"
      - "link-activity"

  default-speeds:
    default: ["10BASE Half-Duplex", "10BASE Full-Duplex", "100BASE Half-Duplex",
              "100BASE Full-Duplex"]
```

## dts/bindings/spi/infineon,spi.yaml
```yaml
# Copyright (c) 2022 Cypress Semiconductor Corporation (an Infineon company) or
# an affiliate of Cypress Semiconductor Corporation
#
# SPDX-License-Identifier: Apache-2.0

description: Infineon CAT1 SPI

compatible: "infineon,spi"

include: [spi-controller.yaml, pinctrl-device.yaml, "infineon,scb.yaml"]

properties:
  reg:
    required: true

  interrupts:
    required: true

  pinctrl-0:
    required: true

  ss-setup-delay:
    type: boolean
    description: |
      Adds 1 extra SPI clock cycle between SS assertion and the first SCK edge
      (1.75 vs default 0.75 cycles). Requires Motorola sub-mode,
      SCLK_CONTINUOUS=0, and oversample > 2. SCB v2+ / PSE84 (EDGE) only.

  ss-hold-delay:
    type: boolean
    description: |
      Adds 1 extra SPI clock cycle between the last SCK edge and SS deassertion
      (1.75 vs default 0.75 cycles). Same hardware requirements as ss-setup-delay.

  ss-inter-frame-delay:
    type: boolean
    description: |
      Adds 1 extra SPI clock cycle inter-frame delay between SS deassertion and
      the next assertion (2.5 vs default 1.5 cycles). Same hardware requirements.

  tx-fill-atomic:
    type: boolean
    description: |
      CUSTOM@NDRS: run the interrupt handler of this SCB with interrupts locked.
      The handler fills the transmit FIFO a byte at a time while the SCB already
      shifts the first bytes out.
      With the continuous select (the default) an interrupt that comes in during
      the fill, or a bus stall, empties the FIFO, the SCB releases the select line
      in the middle of the transfer and a read returns the rest of the block as 0xff.
      A handler runs for a few microseconds (the transfers of the interrupt path are
      128 bytes or less), so enable it on a bus whose slave must not see a split
      transfer (the settings FRAM).
```
