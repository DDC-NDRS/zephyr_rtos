## dts/bindings/adc/nxp,s32-adc-sar.yaml
```yaml
# Copyright 2023 NXP
# SPDX-License-Identifier: Apache-2.0

description: NXP S32 ADC SAR controller

compatible: "nxp,s32-adc-sar"

include: [adc-controller.yaml, pinctrl-device.yaml]

properties:
  reg:
    required: true

  interrupts:
    required: true

  vref-mv:
    type: int
    default: 3300
    description: Indicates the reference voltage of the ADC in mV.

  group-channel:
    type: string
    default: "precision"
    enum:
      - "precision"
      - "standard"
      - "external"
    description: |
      Default ADC group channel for this node. Used by any channel@N child
      that does not specify its own group-channel override.

  high-speed:
    type: boolean
    description: Use high speed during conversion, calibration.

  callback-select:
    type: string
    default: "normal-end-conversion"
    enum:
      - "normal-end-conversion"
      - "normal-end-chain"
    description: |
      Select normal end conversion callback to reduce interrupt handling time.
      Select normal end chain callback to reduce the number of interrupt occurrences.

  "#io-channel-cells":
    const: 1

io-channel-cells:
  - input

child-binding:
  properties:
    channel-number:
      type: int
      description: |
        Physical ADC channel number for this channel, exactly as listed in
        the SoC reference manual's ADC channel mapping table (a single flat
        numbering across precision/standard/external groups and any
        internal channels such as bandgap/tempsensor/vrefl/vrefh, e.g.
        0-7 = precision, 32-55 = standard, 64-95 = external on a 3-group
        instance with 32 channels per group).

        `reg` is a SEPARATE, Zephyr-only channel_id (must be unique per
        node, 0-31, since it is also the bit position in
        adc_sequence.channels) and is not necessarily the same number as
        this channel-number: e.g. a node mixing groups needs distinct `reg`
        values per channel even though their true silicon channel numbers
        may not fit in 0-31 or may collide once folded into that range.

        If unset, defaults to `<parent's group-channel index> * 32 + reg`,
        i.e. today's single-group behavior where reg already doubles as
        the group-local index.
```

## dts/bindings/bms/sps/nxp,mc33hb2000.yaml
```yaml
# Copyright (c) 2026 NDR Solution (Thailand) Co., Ltd.
# SPDX-License-Identifier: Apache-2.0

description: MC33HB2000 H-Bridge, SPI programmable

compatible: "nxp,mc33hb2000"

include: [spi-device.yaml]

properties:
    int-gpios:
      type: phandle-array
      required: true
      description: |
        Interrupt pin.

        This pin signals active low when produced by the controller. The
        property value should ensure the flags properly describe the signal
        that is presented to the driver.
    reg:
      type: array
      required: true
```

## tests/drivers/spi/spi_loopback/boards/nucleo_h743zi.conf
```kconfig
# SPDX-FileCopyrightText: Copyright The Zephyr Project Contributors
# SPDX-License-Identifier: Apache-2.0

CONFIG_NOCACHE_MEMORY=y
CONFIG_SPI_STM32_DMA=y
```
